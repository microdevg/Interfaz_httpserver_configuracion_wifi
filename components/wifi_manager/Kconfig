## components/wifi_manager/Kconfig
```kconfig
menu "Opciones de configuración del Servidor HTTPS ESP32"

    config WIFI_SSID
        string "Nombre de la red Wi-Fi (SSID)"
        default "WMESP32"
        help
            Establece el SSID de la red Wi-Fi a la que se conectará el ESP32.
            Esto corresponderá a #define NAME_ESP_WIFI.

    config WIFI_PASSWORD
        string "Contraseña de la red Wi-Fi (PSK)"
        default ""
        help
            Establece la contraseña de la red Wi-Fi (PSK).
            Déjalo vacío si la red es abierta.
            Esto corresponderá a #define PASS_ESP_WIFI.

    config DNS_SERVER_NAME
        string "Nombre de Host DNS del Servidor"
        default "esp32-server"
        help
            Establece el nombre que se usará para acceder al servidor a través de DNS
            (ej: http://esp32-server.local). Debe ser único en la red.
            Esto corresponderá a #define DNS_NAME_PAGE.

endmenu
```

## sdkconfig.defaults
```kconfig
CONFIG_IDF_TOOLCHAIN="gcc"
CONFIG_IDF_TOOLCHAIN_GCC=y
CONFIG_IDF_TARGET_ARCH_XTENSA=y
CONFIG_IDF_TARGET_ARCH="xtensa"
CONFIG_IDF_TARGET="esp32"

CONFIG_IDF_TARGET_ESP32=y


CONFIG_ESPTOOLPY_FLASHSIZE="4MB"
# CONFIG_ESPTOOLPY_HEADER_FLASHSIZE_UPDATE is not set
CONFIG_ESPTOOLPY_BEFORE_RESET=y
# CONFIG_ESPTOOLPY_BEFORE_NORESET is not set
CONFIG_ESPTOOLPY_BEFORE="default_reset"
CONFIG_ESPTOOLPY_AFTER_RESET=y
# CONFIG_ESPTOOLPY_AFTER_NORESET is not set
CONFIG_ESPTOOLPY_AFTER="hard_reset"
CONFIG_ESPTOOLPY_MONITOR_BAUD=115200
# end of Serial flasher config


#
# HTTP Server
#
CONFIG_HTTPD_MAX_REQ_HDR_LEN=800
CONFIG_HTTPD_MAX_URI_LEN=512
CONFIG_HTTPD_ERR_RESP_NO_DELAY=y
CONFIG_HTTPD_PURGE_BUF_LEN=32
# CONFIG_HTTPD_LOG_PURGE_DATA is not set
# CONFIG_HTTPD_WS_SUPPORT is not set
# CONFIG_HTTPD_QUEUE_WORK_BLOCKING is not set
CONFIG_HTTPD_SERVER_EVENT_POST_TIMEOUT=2000
# end of HTTP Server
# --- Configuraciones Personalizadas de Wi-Fi y DNS ---
CONFIG_WIFI_SSID="WMESP32"
CONFIG_WIFI_PASSWORD=""
CONFIG_DNS_SERVER_NAME="esp32-server"
```
